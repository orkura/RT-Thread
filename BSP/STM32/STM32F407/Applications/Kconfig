## BSP/STM32/STM32F407/Debug/CAN1/Kconfig
```kconfig
config BSP_USING_CAN1_DEBUG
    bool "Enable CAN1 FinSH debug command"
    depends on BSP_USING_CAN1 && RT_USING_CAN
    depends on RT_USING_FINSH && FINSH_USING_MSH
    depends on FINSH_USING_OPTION_COMPLETION
    depends on RT_USING_TIMER_SOFT && RT_USING_MUTEX
    default n
    help
        Enable the "can1" FinSH command for interactive CAN1 debugging.
        It supports normal operation, message transmission/reception, status
        inspection, command completion, parameter help, periodic non-blocking
        broadcasting, and internal loopback testing at 250 kbit/s by default.
```

## BSP/STM32/STM32F407/Kconfig
```kconfig
mainmenu "STM32F407 BSP Configuration"

BSP_DIR := .
PROJECT_DIR := ../../..
RTT_DIR := $(PROJECT_DIR)/RT-Thread

rsource "../Libraries/Kconfig"

config SOC_STM32F407ZG
    bool
    select SOC_SERIES_STM32F4
    select RT_USING_COMPONENTS_INIT
    select RT_USING_USER_MAIN
    default y

rsource "Applications/Kconfig"
rsource "Debug/Kconfig"

rsource "$(RTT_DIR)/Kconfig"

if SOC_STM32F407ZG && !RT_USING_NANO
rsource "Board/Kconfig"
endif

# BSP-specific components own their Kconfig entries through this aggregator.
rsource "Components/Kconfig"
```

## BSP/STM32/STM32H743/Debug/FDCAN2/Kconfig
```kconfig
config BSP_USING_FDCAN2_DEBUG
    bool "Enable FDCAN2 FinSH debug command"
    depends on BSP_USING_FDCAN2 && RT_USING_CAN && RT_CAN_USING_CANFD
    depends on RT_USING_FINSH && FINSH_USING_MSH
    depends on FINSH_USING_OPTION_COMPLETION
    depends on RT_USING_SEMAPHORE
    default n
```
